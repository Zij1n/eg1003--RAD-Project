#include <ESP8266WiFi.h>
#include <fstream>
#include <SPI.h>
#include <Wire.h>
#include <Adafruit_GFX.h>
#include <Adafruit_SSD1306.h>

#define SCREEN_WIDTH 128 // OLED display width, in pixels
#define SCREEN_HEIGHT 64 // OLED display height, in pixels
const unsigned char Logo [] PROGMEM = {
  // Logo, 128x50px
  0xff, 0xff, 0xff, 0xff, 0xff, 0xff, 0xff, 0xff, 0xff, 0xff, 0xff, 0xff, 0xff, 0xff, 0xff, 0xff, 
  0xff, 0xff, 0xff, 0xff, 0xff, 0xff, 0xff, 0xff, 0xff, 0xff, 0xff, 0xff, 0xff, 0xff, 0xff, 0xff, 
  0xff, 0xff, 0xff, 0xff, 0xff, 0xff, 0xff, 0xff, 0xde, 0x3f, 0xff, 0xff, 0xff, 0xff, 0xff, 0xff, 
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  0xff, 0xff, 0xff, 0xff, 0xff, 0xe0, 0x00, 0x00, 0x00, 0x00, 0x00, 0x1f, 0xff, 0xff, 0xff, 0xff
};


Adafruit_SSD1306 display(SCREEN_WIDTH, SCREEN_HEIGHT, &Wire, -1); // initialize display


// AP info
const char* ssid = "Galaxy";
const char* password = "catcatcat";

//start server
WiFiServer server(80);
//pin for motor
int ENA=14;
int IN1=12;
int IN2=13;
//varible initialize
int ena;
String State = "";
String request;

//client object
WiFiClient client;

void setup() {
  // serial begin at 9600
  Serial.begin(9600);
  delay(10);
  // start display
  display.begin(SSD1306_SWITCHCAPVCC, 0x3C); 
   //clear buffer 
  display.clearDisplay(); 
  //format
  display.setTextSize(1);  
  display.setTextColor(WHITE);  
  // default pwm 
  ena=700 ;
 //pinmode setup
  pinMode(ENA, OUTPUT);
  pinMode(IN1, OUTPUT);
  pinMode(IN2, OUTPUT);

  // Connect to WiFi 
  Serial.println();
  Serial.print("Connecting to ");
  Serial.println(ssid);
 
  WiFi.begin(ssid, password);
 
  while (WiFi.status() != WL_CONNECTED) {
    delay(500);
    Serial.print(".");
  }
  Serial.println("");
  Serial.println("WiFi connected");
 
  // Start  server
  server.begin();
  Serial.println("Server started");
 
  // Print the IP address
  Serial.print("http://");
  Serial.print(WiFi.localIP());
  Serial.println("/");
  //show on screen
  ipshow();
  


 
}

void ipshow(){
  display.clearDisplay(); 
  display.setCursor(0, 0);
  display.println(WiFi.localIP());
  display.drawBitmap(0, 14,  Logo, 128, 56, WHITE);
  display.display();
  }
 
void loop() {
  
  
  // Check if a client has connected
  client = server.available();
  if (!client) {
    return;
  }
 
  // Wait 
  Serial.print(" { ");
  while(!client.available()){
    delay(1);
  }

  readReq(); // Read the client request
  
  processReq(); // Perform action on request
  
  delay(1);
  Serial.println(" } ");
  Serial.println("");
 
}

void readReq() {
  // Read the first line of the request
  request = client.readStringUntil('\r');
 Serial.println(request);
  client.flush();
  // Match the request
//set to high speed
if (request.indexOf("/high") != -1)  {
    ena=1000;
  }
//set to low speed
if (request.indexOf("/slow") != -1)  {
    ena=750   ;
  }
//turn on
  if (request.indexOf("/on") != -1)  {
    analogWrite(ENA, ena);
    digitalWrite(IN1, HIGH);
    digitalWrite(IN2, LOW);
    Serial.print("on!");
    State="On";
  }
 //turn off
  if (request.indexOf("/off") != -1)  {
    digitalWrite(IN1, LOW);
    digitalWrite(IN2, LOW);
    Serial.print("off!");
    State="Off";
  }



}

void processReq() { 

  // response
  client.println("HTTP/1.1 200 OK");
  client.println("Content-Type: text/html");
  client.println(""); 
  //different response
  client.print("<!DOCTYPE HTML><html><head><meta name=\"viewport\" content=\"user-scalable=no,maximum-scale=1\"><style>body{width:100%; padding:0; margin:0;}.bx{text-align:center; padding:25% 2px;}.row{}.w25{width:25% !important;}.w50{width:49% !important;}.w75{width:75% !important;}.w100{width:100% !important;}.btn{min-height:20vw; border-radius:20em; font-size:8em;}</style></head>");
  if (State=="On"){
  client.println("<body ><div class=\"bx\"><div class=\"row\"><a href=\"/on\"><button class=\"btn bt-f w75\" style=\"background-color:rgb(139,195,74)\">ON</button></a></div><button class=\"btn w50\" style=\"background-color:rgb(255, 0, 0)\">:ON</button><div class=\"row\"><a href=\"/off\"><button class=\"btn bt-l w75\" style=\"background-color:rgb(255,152,0)\">OFF</button></a></div></body></html>");
  }
  else{
  client.println("<body ><div class=\"bx\"><div class=\"row\"><a href=\"/on\"><button class=\"btn bt-f w75\" style=\"background-color:rgb(139,195,74)\">ON</button></a></div><button class=\"btn w50\" style=\"background-color:rgb(255, 0, 0)\">:OFF</button><div class=\"row\"><a href=\"/off\"><button class=\"btn bt-l w75\" style=\"background-color:rgb(255,152,0)\">OFF</button></a></div></body></html>");
    }
  }
